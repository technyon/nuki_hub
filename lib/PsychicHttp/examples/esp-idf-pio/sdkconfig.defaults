## lib/PsychicHttp/examples/esp-idf-pio/sdkconfig.defaults
```kconfig
# Default sdkconfig overrides for the esp-idf-pio build-validation example.
# PlatformIO merges this into the generated sdkconfig on every build.

# PsychicHttp requires WebSocket support in esp_http_server.
CONFIG_HTTPD_WS_SUPPORT=y

# Enable ESP-IDF HTTPS server (required by PsychicHttpsServer.h).
CONFIG_ESP_HTTPS_SERVER_ENABLE=y

# Ensure software mbedTLS MD5 implementation is compiled (not ROM-only).
# PsychicHttp calls mbedtls_md5_* directly for digest auth.
# CONFIG_MBEDTLS_ROM_MD5 is not set
```

## lib/PsychicHttp/examples/esp-idf/sdkconfig.defaults
```kconfig
CONFIG_AUTOSTART_ARDUINO=y
# CONFIG_WS2812_LED_ENABLE is not set
CONFIG_FREERTOS_HZ=1000

CONFIG_BOOTLOADER_COMPILER_OPTIMIZATION_SIZE=y
CONFIG_COMPILER_OPTIMIZATION_SIZE=y

#
# Serial flasher config
#
CONFIG_ESPTOOLPY_FLASHMODE_QIO=y
CONFIG_ESPTOOLPY_FLASHSIZE_4MB=y
CONFIG_ESPTOOLPY_FLASHSIZE="4MB"

#
# Partition Table
#
CONFIG_PARTITION_TABLE_CUSTOM=y
CONFIG_PARTITION_TABLE_CUSTOM_FILENAME="partitions_custom.csv"
#CONFIG_PARTITION_TABLE_FILENAME="partitions_custom.csv"
#CONFIG_PARTITION_TABLE_OFFSET=0xE000
CONFIG_PARTITION_TABLE_MD5=y

#
# ESP HTTPS OTA
#
CONFIG_ESP_HTTPS_OTA_DECRYPT_CB=y
CONFIG_ESP_HTTPS_OTA_ALLOW_HTTP=y
# end of ESP HTTPS OTA


#
# ESP HTTP client
#
CONFIG_ESP_HTTP_CLIENT_ENABLE_HTTPS=y
CONFIG_ESP_HTTP_CLIENT_ENABLE_BASIC_AUTH=y
CONFIG_ESP_HTTP_CLIENT_ENABLE_DIGEST_AUTH=y
# end of ESP HTTP client

#
# HTTP Server
#
CONFIG_HTTPD_MAX_REQ_HDR_LEN=1024
CONFIG_HTTPD_MAX_URI_LEN=512
CONFIG_HTTPD_ERR_RESP_NO_DELAY=y
CONFIG_HTTPD_PURGE_BUF_LEN=32
# CONFIG_HTTPD_LOG_PURGE_DATA is not set
CONFIG_HTTPD_WS_SUPPORT=y
# end of HTTP Server

#
# ESP HTTPS server
#
CONFIG_ESP_HTTPS_SERVER_ENABLE=n
# end of ESP HTTPS server


#
# TLS Key Exchange Methods
#
# 2 option require for arduino Arduino
CONFIG_MBEDTLS_PSK_MODES=y
CONFIG_MBEDTLS_KEY_EXCHANGE_PSK=y
```

## lib/espMqttClient/Kconfig.projbuild
```kconfig
menu "espMqttClient Configuration"

config EMC_TX_TIMEOUT
    int "TX Timeout"
    default 10000
    help
        Timeout in milliseconds before a (qos > 0) message will be retransmitted.

config EMC_RX_BUFFER_SIZE
    int "RX Buffer size"
    default 1440
    help
        The sets the size of the buffer to copy incoming data into.

config EMX_TX_BUFFER_SIZE
    int "TX Buffer size"
    default 1440
    help
        When publishing using the callback, the client fetches data in chunks of EMC_TX_BUFFER_SIZE size.
        This is not necessarily the same as the actual outging TCP packets.

config EMC_MAX_TOPIC_LENGTH
    int "Max topic length"
    default 128
    help
        For **incoming** messages, a maximum topic length is set. Topics longer than this will be truncated.

config EMC_PAYLOAD_BUFFER_SIZE
    int "Payload buffer size"
    default 32
    help
        Set the incoming payload buffer size for SUBACK messages.
        When subscribing to multiple topics at once, the acknowledgement contains all the return codes in its payload.
        The default of 32 means you can theoretically subscribe to 32 topics at once.

config EMC_MIN_FREE_MEMORY
    int "Minimum free memory"
    default 4096
    help
        The client keeps all outgoing packets in a queue which stores its data in heap memory.
        With this option, you can set the minimum available (contiguous) heap memory that needs to
        be available for adding a message to the queue.

config EMC_ALLOW_NOT_CONNECTED_PUBLISH
    bool "Allow publish when not connected"
    default n
    help
        By default, you can publish when the client is not connected. If you don't want this, set this to 0.
        Regardless of this setting, after you called `disconnect()`, no messages can be published until fully disconnected.

config EMC_WAIT_FOR_CONNACK
    bool "Wait for CONNACK"
    default y
    help
        By default, espMqttClient waits for the CONNACK (connection acknowledge) packet before starting to send other packets.
        The MQTT specification allows to start sending before the broker acknowledges the connection but some brokers
        don't allow this (AWS for example doesn't).

config EMC_CLIENTID_LENGTH
    int "Client ID length"
    default 19
    help
        The (maximum) length of the client ID. (Keep in mind that this is a c-string. You need to have 1 position available for the null-termination.)

config EMC_TASK_STACK_SIZE
    int "Task stack size"
    default 5120
    help
        Sets the stack size (in words) of the MQTT client worker task.

config EMC_MULTIPLE_CALLBACKS
    bool "Multiple callbacks"
    default n
    help
        This macro is by default not enabled so you can add a single callbacks to an event. Assigning a second will overwrite the existing callback.
        When enabling multiple callbacks, multiple callbacks (with uint32_t id) can be assigned. Removing is done by referencing the id.

config EMC_USE_MEMPOOL
    bool "Use memory pool"
    default n
    help
        When set to `1`, (outgoing) MQTT packets and the outbox data is stored in a memory pool.
        The memory pool is part of the espMqttClient object and is thus allocated in the same memory type.
        There are two pools: one to hold the outgoing packets (dynamic size elements) and one for the outbox itself (fixed-size elements).

    config EMC_NUM_POOL_ELEMENTS
        int "Number of pool elements"
        default 32
        depends on EMC_USE_MEMPOOL
        help
            This config variable is only used when enabling the memory pool. It defines the number of elements in the outbox-pool
            and the number of blocks that will be allocated in the packet-pool

    config EMC_SIZE_POOL_ELEMENTS
        int "Memory pool packet size"
        default 128
        depends on EMC_USE_MEMPOOL
        help
            This defines the size of one packet-pool element. Together with `EMC_NUM_POOL_ELEMENTS`, you get the total packet-pool size.
            The packet-pool can hold any size of element. The configuration only guarantees a minimum of `EMC_NUM_POOL_ELEMENTS` of size `EMC_SIZE_POOL_ELEMENTS` can fit in the pool.
endmenu
```

## lib/espMqttClient/examples/simple-esp32-idf/sdkconfig.defaults
```kconfig
#
# Bootloader config
#
CONFIG_BOOTLOADER_COMPILER_OPTIMIZATION_SIZE=y
CONFIG_BOOTLOADER_LOG_LEVEL_NONE=y
CONFIG_BOOTLOADER_LOG_LEVEL=0

#
# Serial flasher config
#
CONFIG_ESPTOOLPY_FLASHMODE_DIO=y
CONFIG_ESPTOOLPY_FLASHMODE="dio"
CONFIG_ESPTOOLPY_FLASHFREQ_40M=y
CONFIG_ESPTOOLPY_FLASHFREQ="40m"
CONFIG_ESPTOOLPY_FLASHSIZE_4MB=y
CONFIG_ESPTOOLPY_FLASHSIZE="4MB"
#
# Partition Table
#
CONFIG_PARTITION_TABLE_CUSTOM=n

#
# Arduino Configuration
#
CONFIG_ARDUINO_VARIANT="esp32"
CONFIG_ENABLE_ARDUINO_DEPENDS=y
CONFIG_AUTOSTART_ARDUINO=y

#
# FreeRTOS
#
# 1000 require for Arduino
CONFIG_FREERTOS_HZ=1000

#ASYNC_TCP
CONFIG_ASYNC_TCP_RUN_NO_AFFINITY=y

#MBEDTLS
CONFIG_MBEDTLS_PSK_MODES=y
```

## resources/espressif__esp_hosted/examples/host_bluedroid_ble_compatibility_test/sdkconfig.defaults
```kconfig
#
# BT config
# - ESP32 co-processor only supports BLE 4.2
#
CONFIG_BT_ENABLED=y
CONFIG_BT_CONTROLLER_DISABLED=y
CONFIG_BT_BLUEDROID_ENABLED=y
CONFIG_BT_BLE_50_FEATURES_SUPPORTED=n
CONFIG_BT_BLE_42_FEATURES_SUPPORTED=y
# CONFIG_BT_LE_50_FEATURE_SUPPORT is not used on ESP32, ESP32-C3 and ESP32-S3.
CONFIG_BT_LE_50_FEATURE_SUPPORT=n

#
# Wi-Fi Remote
#
CONFIG_ESP_WIFI_REMOTE_LIBRARY_HOSTED=y

#
# Enable ESP Hosted BT
# Used as VHCI transport between BT Host and Controller
#
CONFIG_ESP_HOSTED_ENABLE_BT_BLUEDROID=y
CONFIG_ESP_HOSTED_BLUEDROID_HCI_VHCI=y
```

## resources/espressif__esp_hosted/examples/host_bluedroid_bt_hid_mouse_device/sdkconfig.defaults
```kconfig
#
# BT config
# - ESP32 co-processor only supports BLE 4.2
#
CONFIG_BT_ENABLED=y
CONFIG_BT_CONTROLLER_DISABLED=y
CONFIG_BT_BLUEDROID_ENABLED=y
CONFIG_BT_CLASSIC_ENABLED=y
CONFIG_BT_HID_ENABLED=y
CONFIG_BT_HID_DEVICE_ENABLED=y
CONFIG_BT_BLE_50_FEATURES_SUPPORTED=n
CONFIG_BT_BLE_42_FEATURES_SUPPORTED=y
CONFIG_BTDM_CTRL_MODE_BLE_ONLY=n
CONFIG_BTDM_CTRL_MODE_BR_EDR_ONLY=y
CONFIG_BTDM_CTRL_MODE_BTDM=n

#
# Wi-Fi Remote
# - set ESP32 as default co-processor
#
CONFIG_ESP_WIFI_REMOTE_LIBRARY_HOSTED=y
CONFIG_SLAVE_IDF_TARGET_ESP32=y

#
# Enable ESP Hosted BT
# Used as VHCI transport between BT Host and Controller
#
CONFIG_ESP_HOSTED_ENABLE_BT_BLUEDROID=y
CONFIG_ESP_HOSTED_BLUEDROID_HCI_VHCI=y
```

## resources/espressif__esp_hosted/examples/host_bluedroid_host_only/sdkconfig.defaults
```kconfig
#
# BT config
# - ESP32 co-processor only supports BLE 4.2
#
CONFIG_BT_ENABLED=y
CONFIG_BT_CONTROLLER_DISABLED=y
CONFIG_BT_BLUEDROID_ENABLED=y
CONFIG_BT_CLASSIC_ENABLED=y
CONFIG_BT_BLE_50_FEATURES_SUPPORTED=n
CONFIG_BT_BLE_42_FEATURES_SUPPORTED=y

#
# Wi-Fi Remote
# - set ESP32 as default co-processor
#
CONFIG_ESP_WIFI_REMOTE_LIBRARY_HOSTED=y
CONFIG_SLAVE_IDF_TARGET_ESP32=y

#
# Enable ESP Hosted BT
# Used as VHCI transport between BT Host and Controller
#
CONFIG_ESP_HOSTED_ENABLE_BT_BLUEDROID=y
CONFIG_ESP_HOSTED_BLUEDROID_HCI_VHCI=
```

## resources/espressif__esp_hosted/examples/host_nimble_bleprph_host_only_vhci/sdkconfig.defaults
```kconfig
# Override some defaults so BT stack is enabled
# in this example

#
# BT config
#
CONFIG_BT_ENABLED=y
CONFIG_BT_CONTROLLER_DISABLED=y
CONFIG_BT_BLUEDROID_ENABLED=n
CONFIG_BT_NIMBLE_ENABLED=y
CONFIG_BT_NIMBLE_TRANSPORT_UART=n

#
# Wi-Fi Remote
#
CONFIG_ESP_WIFI_REMOTE_LIBRARY_HOSTED=y

#
# Enable ESP Hosted BT
# Used as VHCI transport between BT Host and Controller
#
CONFIG_ESP_HOSTED_ENABLE_BT_NIMBLE=y
CONFIG_ESP_HOSTED_NIMBLE_HCI_VHCI=y
```
